## Kconfig
```kconfig
#
# For a description of the syntax of this configuration file,
# see Documentation/kbuild/kconfig-language.txt.
#
mainmenu "Proxmark3 Configuration"

#config SRCARCH
#	string
#	option env="SRCARCH"

#source "arch/$SRCARCH/Kconfig"


#menu "Compile-time checks and compiler options"

choice
    prompt "Repository"
    default REPO__RfidResearchGroup

config REPO__RfidResearchGroup
    bool "Rfid Research Group"
    help
      Official Repository

config REPO__TestRepo
    bool "TestRepoStub"
    help
      This is just a stub for adding new repos

endchoice

#------------------------------
choice
    depends on REPO__RfidResearchGroup
	prompt "Platform"
	default PLATFORM__PM3RDV4

config PLATFORM__PM3RDV4
	bool "Proxmark3 RDV4"
	help
	  This is the latest platform.

config PLATFORM__PM3OTHER
	bool "Proxmark3 all other platforms"
	help
	  This is for all other Proxmark3 platforms

config PLATFORM__PM3ICOPYX
	bool "iCopy-X with XC3S100E"
	help
	  This is the new iCopy-X device

endchoice

#------------------------------
config PLATFORM_EXTRAS__BTADDON
	bool "BlueShark addon"
    depends on PLATFORM__PM3RDV4
	help
        BlueShark is bringing the following functionality to your existing Proxmark 3:

        - Standalone Mode
        - Offline sniffing
        - Offline reading & simulation

        Built with penetration testers in mind, this upgrade consists of:

        - Bluetooth 2.0 EDR module
        - Rechargeable polymer lithium-ion Battery module
        - Aluminium case + heatsink
        - Tempered glass cover

#------------------------------
choice
    depends on REPO__RfidResearchGroup
    prompt ""
    default STANDALONE__MSDSAL
#------------------------------

config STANDALONE__
    bool "empty         : Disable standalone"
    help
        This will compile without any standalone module.

config STANDALONE__LF_SKELETON
    bool "LF_SKELETON   : standalone mode skeleton"
    help
        - Long press button until Several LED flash in sequence
        - LED C is now lit
        - Long press button until LED D lights as well as C
        - Place card on antenna to be read
        - D goes off when card is read
        - Short press button
        - B and C is lit
        - Card is now being Emulated

        Author: Iceman

config STANDALONE__LF_EM4100EMUL
    bool "LF_EM4100EMUL : Simulate predefined em4100 tags only"
    help
        Author: Unknown

config STANDALONE__LF_EM4100RSWB
    bool "LF_EM4100RSWB : Read/Simulate/Brute em4100 tags & clone it to T555x tags"
    help
        Author: Unknown

config STANDALONE__LF_EM4100RSWW
    bool "LF_EM4100RSWW : Read/Simulate/Brute em4100 tags & clone it to T555x tags, wipe T55xx tags"
    help
        Author: Unknown

config STANDALONE__LF_EM4100RWC
    bool "LF_EM4100RWC  : Read/Simulate em4100 tags & clone it to T555x tags"
    help
        Author: Unknown

config STANDALONE__LF_HIDBRUTE
    bool "LF_HIDBRUTE   : HID corporate 1000 bruteforce"
    help
        - Hold button until lights flash and release.
        - C stays lit.
        - Short press button until: A&C are lit
        - Hold button until A&C&D are lit
        - Scan a valid card
        - Short press button: B&C&A stay lit
        - It is now brute forcing the key space starting with the scanned card and decrements card numbers
        - Short press the button again to increment card numbers

        Author: Federico dotta & Maurizio Agazzini

config STANDALONE__LF_HIDFCBRUTE
    depends on PLATFORM__PM3RDV4
    bool "LF_HIDRCBRUTE : HID Facility Code Bruteforce - (RDV4 only)"
    help
	Author: Unknown

config STANDALONE__LF_ICEHID
    depends on PLATFORM__PM3RDV4
    bool "LF_ICEHID     : LF HID collector to flashmem"
    help
        Author: Unknown

config STANDALONE__LF_NEXID
    depends on PLATFORM__PM3RDV4
    bool "LF_NEXID     : LF Nexwatch collector to flashmem"
    help
        Author: Unknown

config STANDALONE__LF_PROXBRUTE
    bool "LF_PROXBRUTE  : HID ProxII bruteforce"
    help
        - Hold button until lights flash and release.
        - C stays lit.
        - Short press button: C&B are lit
        - Short press button: only A is lit
        - Hold button until A&D light up
        - Scan a valid card
        - Short press button: B&C&A stay lit
        - It is now brute forcing the key space starting with the scanned card and decrements the hex values until you find a new valid card

        Author: Brad Antoniewicz

config STANDALONE__LF_SAMYRUN
    bool "LF_SAMYRUN    : HID26 read/clone/sim"
    help
        READ/SIM of LF HID26 tags.

        Author: Samy Kamkar

config STANDALONE__HF_THAREXDE
    depends on PLATFORM__PM3RDV4
    bool "HF_THAREXDE   : Simulate/read EM4x50 tags storing in flashmem"
    help
	Author: Unknown

config STANDALONE__HF_14ASNIFF
    bool "HF_14ASNIFF   : 14a sniff to flashmem (rdv4) or ram"
    help
        Author: Unknown

config STANDALONE__HF_14BSNIFF
    bool "HF_14BSNIFF   : 14b sniff to flashmem (rdv4) or ram"
    help
        Author: Unknown

config STANDALONE__HF_15SNIFF
    depends on PLATFORM__PM3RDV4
    bool "HF_14ASNIFF   : 15693 sniff to flashmem"
    help
        Author: Unknown

config STANDALONE__HF_AVEFUL
    bool "HF_AVEFUL     : Mifare ultralight read/simulation"
    help
        Author: Ave Ozkal

config STANDALONE__HF_BOG
    depends on PLATFORM__PM3RDV4
    bool "HF_BOG        : 14a sniff with ULC/ULEV1/NTAG auth storing in flashmem"
    help
        Author: Bogito

config STANDALONE__HF_COLIN
    depends on PLATFORM__PM3RDV4
    bool "HF_COLIN      : Mifare ultra fast sniff/sim/clone"
    help
        Author: Colin Brigato

config STANDALONE__HF_CRAFTBYTE
    bool "HF_CRAFTBYTE  : UID stealer - Emulates scanned 14a UID"
    help
        Author: Anze Jensterle

config STANDALONE__HF_ICECLASS
    depends on PLATFORM__PM3RDV4
    bool "HF_ICECLASS   : Simulate HID iCLASS legacy ags stored in flashmem"
    help
        Author: Ave Ozkal

config STANDALONE__HF_LEGIC
    bool "HF_LEGIC      : Read/Simulate Legic Prime tags storing in flashmem"
    help
        Author: Unknown

config STANDALONE__HF_LEGICSIM
    depends on PLATFORM__PM3RDV4
    bool "HF_LEGICSIM   : Read/Simulate Legic Prime tags storing in flashmem"
    help
        Author: Unknown

config STANDALONE__HF_MATTYRUN
    bool "HF_MATTYRUN   : Mifare sniff/clone"
    help
        - Hold card up to antenna.
        - Long press button.
        - A&D light and B flashes if card is held to antenna.
        - Wait for A&D to go off and B will stay lit.
        - Mifare card is now being emulated.
        - Press button again to clone the card to a Chinese magic card.

        Note: If C stays lit then the keys were not found and tag can not be emulated.
        Try holding tag over antenna before pressing the button and try again.

        Author: Matias A. Re Medina

config STANDALONE__HF_MFCSIM
    depends on PLATFORM__PM3RDV4
    bool "HF_MFCSIM     : Simulate Mifare Classic 1k card storing in flashmem"
    help
        Author: Ray Lee

config STANDALONE__HF_MSDSAL
    bool "HF_MSDSAL     : Read and emulate MSD Visa cards"
    help
        Author: Salvador Mendoza

config STANDALONE__HF_REBLAY
    depends on PLATFORM__PM3RDV4
    bool "HF_REBLAY     : 14A Relay over BT"
    help
        Author: Salvador Medoza

config STANDALONE__HF_TCPRST
    bool "HF_TCPRST     : IKEA Rothult read/sim/dump/emul"
    help
        Author: Nco Draffen

config STANDALONE__HF_TMUDFORD
    depends on PLATFORM__PM3RDV4
    bool "HF_TMUDFORD   : Read and emulate 15 tags"
    help
        Author: Tim Mudford

config STANDALONE__HF_YOUNG
    bool "HF_YOUNG      : Mifare sniff/simulation"
    help
        Author: Craig Young

config STANDALONE__DANKARMULTI
    bool "DANKARMULTI   : Load multiple standalone modes"
    help
        Author: Daniel Karling

endchoice

    menu "Disable features"

        config SKIP_LF
            bool "Skip LF"

        config SKIP_HITAG
	    bool "Skip HITAG"

	config SKIP_EM4x50
	    bool "Skip EM4x50"

	config SKIP_ISO15693
	    bool "Skip ISO15693"

	config SKIP_LEGICRF
	    bool "Skip LEGICRF"

	config SKIP_ISO14443b
	    bool "Skip ISO14443b"

	config SKIP_ISO14443a
	    bool "Skip ISO14443a"
	    
	config SKIP_ICLASS
	    bool "Skip ICLASS"

	config SKIP_FELICA
	    bool "Skip FELICA"

	config SKIP_NFCBARCODE
	    bool "Skip NFCBARCODE"

	config SKIP_HFSNIFF
	    bool "Skip HFSNIFF"

	config SKIP_HFPLOT
	    bool "SKIP_HFPLOT"

	config SKIP_ZX8211
	    bool "Skip ZX8211"

    
       endmenu

#------------------------------
menu "Build environment"

    config THREADS
        int "Number of build threads (2-8)"
        range 2 8
        default 2
        help
            Number of build threads to use (make -j #)

            Range: 2 - 8

    config GETDEPENDENCIES
        bool "Get Build dependencies"
        default n
        help
            Make sure all build dependencies are met:
             - p7zip
             - git
             - build-essential
             - libreadline5
             - libreadline-dev
             - libusb-0.1-4
             - libusb-dev
             - libqt4-dev
             - perl
             - pkg-config
             - wget
             - libncurses5-dev
             - gcc-arm-none-eabi
             - libstdc++-arm-none-eabi-newlib
             - libpcsclite-dev pcscd

    config GITDOWNLOAD
        bool "Download/update Proxmark3 repository"
        help
            Download latest Proxmark3 code from repository.

            Repository: https://github.com/RfidResearchGroup/proxmark3.git
        default y


    config BUILD
        bool "Build code"
        default y


    choice
        prompt "Build code"
        depends on BUILD
        default BUILDCLEAN

        config BUILDCLEAN
            bool "Make clean build"

        config BUILDCODE
            bool "Just Make"

    endchoice

    config INSTALL
        bool "Install image"
        default "y"

    config FLASHBOOT
        depends on INSTALL
        bool "Flash Boot Image"
        default "y"

    config FLASHFULL
        depends on INSTALL
        bool "Flash Full Image"
        default "y"

    config CHECKVERSION
        bool "Check Proxmark3 installation"
        default "y"

endmenu


#source "main/Kconfig"

#source "lib/Kconfig"
```
